## sdkconfig.defaults
```kconfig
CONFIG_IDF_TARGET="esp32c6"

# ────────── Flash / partitions ──────────
CONFIG_ESPTOOLPY_FLASHMODE_QIO=y
CONFIG_ESPTOOLPY_FLASHSIZE_8MB=y
CONFIG_ESPTOOLPY_FLASHFREQ_80M=y          # max flash clock (XiP / WAD reads faster)

CONFIG_PARTITION_TABLE_CUSTOM=y
CONFIG_PARTITION_TABLE_CUSTOM_FILENAME="partitions.csv"

# Console
CONFIG_ESP_CONSOLE_USB_SERIAL_JTAG=y

# ────────── Speed ──────────
CONFIG_ESP_DEFAULT_CPU_FREQ_MHZ_160=y
# Optimize for size, not speed. The renderer was -O2; -Os typically loses
# a few percent FPS on it but saves ~80 KiB of flash, which we trade for
# a bigger WAD partition. If FPS regression is measurable, restore
# OPTIMIZATION_PERF and add __attribute__((optimize("O2"))) to the
# R_DrawColumn family in r_draw.c.
CONFIG_COMPILER_OPTIMIZATION_SIZE=y       # -Os
# (LTO would be the next lever — ESP-IDF v5.5.2 doesn't expose it as a
# Kconfig option; enabling whole-program LTO requires plumbing -flto
# into target_compile_options and link_options manually, plus rebuilding
# IDF components. Worth ~30–60 KiB if needed.)
CONFIG_FREERTOS_HZ=1000

# ────────── Reclaim every byte of RAM for DOOM ──────────
# Force every wireless subsystem off at compile time. CONFIG_ESP_WIFI_*
# are auto-y on C6 because SOC_WIFI_SUPPORTED=y, but we never call
# esp_wifi_init() so the dynamic buffers stay unallocated. The static
# WiFi RX/TX queue counts and beacon buffers can still be reduced to
# their minimums to shrink any baseline state.
CONFIG_BT_ENABLED=n
CONFIG_ESP_WIFI_ENABLED=n
CONFIG_ESP_PHY_ENABLED=n
CONFIG_IEEE802154_ENABLED=n
CONFIG_OPENTHREAD_ENABLED=n
CONFIG_ESP_COEX_SW_COEXIST_ENABLE=n
CONFIG_ESP_PHY_CALIBRATION_AND_DATA_STORAGE=n
# WiFi buffer counts to minimum (in case anything still references them).
# WIFI_RX_BA_WIN must be <= 2 * WIFI_STATIC_RX_BUFFER_NUM, so keep them
# in step. These are only allocated if esp_wifi_init() runs (we don't),
# so the values are mostly cosmetic.
CONFIG_ESP_WIFI_STATIC_RX_BUFFER_NUM=4
CONFIG_ESP_WIFI_DYNAMIC_RX_BUFFER_NUM=8
CONFIG_ESP_WIFI_DYNAMIC_TX_BUFFER_NUM=8
CONFIG_ESP_WIFI_RX_BA_WIN=4
CONFIG_ESP_WIFI_RX_MGMT_BUF_NUM_DEF=1

# LWIP is unused (no networking). Disabling its various subsystems
# reclaims a few KB of static buffers — IPv6 stubs alone are ~7 KB, the
# stats counters another ~3-5 KB, plus the TCPIP task stack.
CONFIG_LWIP_TCP_QUEUE_OOSEQ=n
CONFIG_LWIP_TCPIP_TASK_STACK_SIZE=2048
CONFIG_LWIP_IPV6=n
CONFIG_LWIP_STATS=n

# Slim FreeRTOS overhead. Stack sizes here are ALL trimmed past
# default — we only run the main DOOM task plus the IDF system tasks
# (idle, timer, ipc-stub). Each KiB cut from these is a KiB freed
# back to the heap. If you add a feature that needs deeper stacks
# (callbacks, ISRs), bump them up here.
CONFIG_FREERTOS_CHECK_STACKOVERFLOW_NONE=y
CONFIG_FREERTOS_QUEUE_REGISTRY_SIZE=0
CONFIG_FREERTOS_TIMER_TASK_STACK_DEPTH=1536
CONFIG_FREERTOS_IDLE_TASK_STACKSIZE=768
CONFIG_FREERTOS_USE_TRACE_FACILITY=n
CONFIG_FREERTOS_GENERATE_RUN_TIME_STATS=n
CONFIG_ESP_TIMER_TASK_STACK_SIZE=2048
CONFIG_ESP_IPC_TASK_STACK_SIZE=512
CONFIG_ESP_SYSTEM_EVENT_TASK_STACK_SIZE=2048

# Disable heap poisoning + tracing — pure speed/RAM win on every malloc.
CONFIG_HEAP_POISONING_DISABLED=y
CONFIG_HEAP_USE_HOOKS=n

# Place heap allocator code into flash (XIP) instead of IRAM. Per the
# Espressif RAM-usage guide this is safe whenever no ISR-from-flash
# path holds the heap lock. We have no SPI ISR running with cache off,
# so this is fine and reclaims a few KiB of IRAM (which on C6 ⇄ DRAM
# splits, eventually flowing through to more usable heap).
CONFIG_HEAP_PLACE_FUNCTION_INTO_FLASH=y
CONFIG_LIBC_LOCKS_PLACE_IN_IRAM=n

# ────────── No watchdog interruptions ──────────
# DOOM's first frame after a level load can take >1 s while it parses lumps.
# Without these, the task watchdog kills us.
CONFIG_ESP_TASK_WDT_INIT=n
CONFIG_ESP_INT_WDT=n
CONFIG_ESP_INT_WDT_TIMEOUT_MS=10000

# ────────── Stacks ──────────
# Main task = the DOOM tick loop. DOOM's call depth is moderate (renderer
# is ~10 levels deep through R_RenderBSPNode recursion, no sound). 8 KB
# has been observed sufficient; bumping back up to 12 KB if we ever see
# a stack-overflow panic.
CONFIG_ESP_MAIN_TASK_STACK_SIZE=8192

# ────────── Logging — strip strings to save flash + CPU ──────────
# LEVEL_NONE drops every ESP_LOG* format string from the binary (≈10–30
# KiB of .rodata strings). Switch to LOG_DEFAULT_LEVEL_WARN locally if
# debugging boot — see sdkconfig.debug.example for an override snippet.
CONFIG_LOG_DEFAULT_LEVEL_NONE=y
CONFIG_LOG_MAXIMUM_EQUALS_DEFAULT=y
# Bootloader logging — only useful during partition-table bring-up.
CONFIG_BOOTLOADER_LOG_LEVEL_NONE=y

# ────────── Newlib nano — smaller printf, less static RAM ──────────
# Saves ~5-8 KB of static RAM that the full newlib's stdio buffers eat.
# Trade-off: no %lf / wide-char support — DOOM only printf's %s/%d/%i.
CONFIG_NEWLIB_NANO_FORMAT=y

# ────────── VFS — strip everything we don't use ──────────
# We have no filesystem: WAD lives in raw flash, mmap'd. The default VFS
# layer drags in several KB of select/dir/termios glue we never touch.
CONFIG_VFS_SUPPORT_SELECT=n
CONFIG_VFS_SUPPORT_DIR=n
CONFIG_VFS_SUPPORT_TERMIOS=n

# ────────── Cache / XiP perf ──────────
# SPI driver was in IRAM for fast LCD blits, but that conflicts with
# HEAP_PLACE_FUNCTION_INTO_FLASH and we need every byte of DRAM more
# than we need DMA-transfer latency. Let it run from flash (XIP); the
# LCD blit is dominated by SPI clock time anyway, not driver overhead.
CONFIG_SPI_MASTER_IN_IRAM=n
CONFIG_SPI_MASTER_ISR_IN_IRAM=n
# RISC-V doesn't allow mid-priority IRQ levels — collapse to 1.
CONFIG_ESP_TIMER_INTERRUPT_LEVEL=1
```
